#include "type.h"
#include <led_display.h>
#include "freemono.h" // Include the FreeMono font
#include "font_test.h" // Include the test font



// Font data arrays
static const uint8_t font5x7[] PROGMEM = {
	0x00, 0x00, 0x00, 0x00, 0x00,// (space)
	0x00, 0x00, 0x5F, 0x00, 0x00,// !
	0x00, 0x07, 0x00, 0x07, 0x00,// "
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	0x08, 0x1C, 0x2A, 0x08, 0x08 // <-   
};



static const uint8_t font8x8[] PROGMEM = {
    0x00, 0x00, 0x00, 0x00, 0x00, 0x00, 0x00, 0x00,   // 0x20, space
    0x18, 0x3C, 0x3C, 0x18, 0x18, 0x00, 0x18, 0x00,   // 0x21, !
    0x6C, 0x6C, 0x00, 0x00, 0x00, 0x00, 0x00, 0x00,   // 0x22, "
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    0x00, 0x00, 0x00, 0x00, 0x00, 0x00, 0x00, 0x00    // 0x7F, DEL
};


// Global variables for text scrolling
static String currentText = "PixelBoard";
static int scrollPosition = 0;
static CRGB textColor = CRGB::White;
static CRGB backgroundColor = CRGB::Black;  // Add background color variable
static unsigned long lastUpdate = 0;
static const int scrollDelay = 50;  // Delay between scroll steps in ms
static bool useMonoFont = false;    // New variable for the FreeMono font

// Helper function to get character index in font array
int getCharIndex(char c) {
    if (useMonoFont) {
        // FreeMono font handles its own character mapping
        return 0;
    } else {
        // For 5x7 font
        // Check for valid characters
        if (c < 32 || c > 126) {
            c = '?'; // Use question mark for invalid characters
        }
        return c - 32; // Adjust for font array that starts at ASCII 32 (space)
    }
}

void drawChar(CRGB* leds, char c, int xOffset, int yOffset) {
    int charIndex = getCharIndex(c);
    
    for (int x = 0; x < 5; x++) {
        if (xOffset + x < 0 || xOffset + x >= 16) continue;
        
        uint8_t column = pgm_read_byte(&font5x7[charIndex * 5 + x]);
        for (int y = 0; y < 7; y++) {
            if (yOffset + y < 0 || yOffset + y >= 16) continue;
            
            if (column & (1 << y)) {
                leds[XY(xOffset + x, yOffset + y)] = textColor;
            }
        }
    }
}

void drawCharLarge(CRGB* leds, char c, int xOffset, int yOffset) {
    int charIndex = getCharIndex(c);
    
    for (int y = 0; y < 8; y++) {
        if (yOffset + y < 0 || yOffset + y >= 16) continue;
        
        uint8_t row = pgm_read_byte(&font8x8[charIndex * 8 + y]);
        for (int x = 0; x < 8; x++) {
            if (xOffset + x < 0 || xOffset + x >= 16) continue;
            
            // Read bits from left to right to match font data orientation
            if (row & (1 << x)) {
                leds[XY(xOffset + x, yOffset + y)] = textColor;
            }
        }
    }
}

// New function to draw characters using the FreeMono font
void drawCharMono(CRGB* leds, unsigned char c, int xOffset, int yOffset, uint8_t size = 1) {
    // Make sure the character is in range for the font
    if (c < 0x20 || c > 0x7E) {
        c = '?'; // Use question mark for invalid characters
    }
    
    // Get the character descriptor from the GFXfont
    const GFXglyph *glyph = &FreeMono24pt7bGlyphs[c - 0x20];
    const uint8_t *bitmap = FreeMono24pt7bBitmaps;
    
    uint16_t bo = glyph->bitmapOffset;
    uint8_t w = glyph->width, h = glyph->height;
    int8_t xo = glyph->xOffset, yo = glyph->yOffset;
    uint8_t xx, yy, bits = 0, bit = 0;
    
    // Scale factor (reduce the size of the large font)
    float scale = 0.3; // Increased from 0.2 to make the font more visible
    
    // Loop through the bitmap data
    for (yy = 0; yy < h; yy++) {
        for (xx = 0; xx < w; xx++) {
            if (!(bit++ & 7)) {
                bits = pgm_read_byte(&bitmap[bo++]);
            }
            
            // Calculate the position on the LED matrix
            int16_t x = xOffset + (int16_t)(xo + xx) * scale;
            int16_t y = yOffset + (int16_t)(yo + yy) * scale + 6; // Added vertical offset to center better
            
            // Check if the bit is set in the bitmap and if the pixel is within the display
            if (bits & 0x80 && x >= 0 && x < 16 && y >= 0 && y < 16) {
                leds[XY(x, y)] = textColor;
            }
            
            bits <<= 1;
        }
    }
}

// New function to draw characters using the test font
void drawCharTest(CRGB* leds, char c, int xOffset, int yOffset, uint8_t size = 1) {
    // Initialize font table if needed
    static bool fontInitialized = false;
    if (!fontInitialized) {
        initFontTable();
        fontInitialized = true;
    }
    
    // Get the letter data for the character
    const LetterData& letter = getLetterData(c);
    
    // If no valid data, skip
    if (letter.data == nullptr) {
        return;
    }
    
    // Scale factor for the font
    float scale = 0.05; // Adjust this as needed to fit the display
    
    // Dimensions of original bitmap (assuming 12 pixels per row in the bitmap)
    int bitmapWidth = letter.width / 12;
    
    // Loop through the bitmap data
    for (int y = 0; y < letter.height; y++) {
        for (int x = 0; x < bitmapWidth; x++) {
            // Calculate index into the data array
            int dataIndex = y * bitmapWidth + x;
            
            // Get the value at this position (0-255)
            uint8_t pixelValue = letter.data[dataIndex];
            
            // If pixel has a value, draw it
            if (pixelValue > 0) {
                // Calculate the position on the LED matrix with scaling
                int16_t displayX = xOffset + (int16_t)(x * scale);
                int16_t displayY = yOffset + (int16_t)(y * scale);
                
                // Check if the pixel is within the display
                if (displayX >= 0 && displayX < 16 && displayY >= 0 && displayY < 16) {
                    // Set color based on pixel value (brighter for higher values)
                    CRGB pixelColor = textColor;
                    pixelColor.nscale8_video(map(pixelValue, 1, 255, 64, 255));
                    leds[XY(displayX, displayY)] = pixelColor;
                }
            }
        }
    }
}

void type(CRGB* leds) {
    // Clear the display with background color instead of black
    fill_solid(leds, NUM_LEDS, backgroundColor);
    
    // Calculate total width of text
    int charWidth = useMonoFont ? 8 : 6; // 8 pixels for mono, 5 pixels + 1 space for small
    
    int totalWidth = currentText.length() * charWidth;
    
    // Update scroll position
    unsigned long currentTime = millis();
    if (currentTime - lastUpdate > scrollDelay) {
        scrollPosition++;
        if (scrollPosition >= totalWidth + 16) {
            scrollPosition = -16;
        }
        lastUpdate = currentTime;
    }
    
    // Draw each character
    for (size_t i = 0; i < currentText.length(); i++) {
        int xPos = 16 - scrollPosition + (i * charWidth);
        if (xPos > -charWidth && xPos < 16) {
            if (useMonoFont) {
                drawCharMono(leds, currentText[i], xPos, 4); // Draw using FreeMono font
            } else {
                drawChar(leds, currentText[i], xPos, 4); // Draw using 5x7 font
            }
        }
    }
}

void setupTypePattern(AsyncWebServer* server) {
    server->on("/type", HTTP_GET, [](AsyncWebServerRequest *request) {
        String html = R"rawliteral(
<!DOCTYPE html>
<html>
<head>
    <title>PixelBoard Text Display</title>
    <meta name="viewport" content="width=device-width, initial-scale=1.0">
    <link rel="stylesheet" href="/style.css">
</head>
<body>
    <div class="preview-container">
        <div class="preview-grid" id="previewGrid"></div>
    </div>
    
    <div class="controls" style="display:block;">
        <div class="input-group">
            <input type="text" id="text-input" placeholder="Enter text to display" value="PixelBoard">
        </div>
        
        <div class="color-section">
            <div class="color-section-label">Text Color</div>
            <div class="color-selection" id="textColors">
                <button class="color-btn active" style="background-color: #FFFFFF;" data-color="white">White</button>
                <button class="color-btn" style="background-color: #FF0000;" data-color="red">Red</button>
                <button class="color-btn" style="background-color: #00FF00;" data-color="green">Green</button>
                <button class="color-btn" style="background-color: #0000FF;" data-color="blue">Blue</button>
                <button class="color-btn" style="background-color: #FFFF00;" data-color="yellow">Yellow</button>
                <button class="color-btn" style="background-color: #FF00FF;" data-color="purple">Purple</button>
                <button class="color-btn" style="background-color: #00FFFF;" data-color="cyan">Cyan</button>
            </div>
        </div>

        <div class="color-section">
            <div class="color-section-label">Background Color</div>
            <div class="color-selection" id="bgColors">
                <button class="color-btn active" style="background-color: #000000;" data-color="black">Black</button>
                <button class="color-btn" style="background-color: #FF0000;" data-color="red">Red</button>
                <button class="color-btn" style="background-color: #00FF00;" data-color="green">Green</button>
                <button class="color-btn" style="background-color: #0000FF;" data-color="blue">Blue</button>
                <button class="color-btn" style="background-color: #FFFF00;" data-color="yellow">Yellow</button>
                <button class="color-btn" style="background-color: #FF00FF;" data-color="purple">Purple</button>
                <button class="color-btn" style="background-color: #00FFFF;" data-color="cyan">Cyan</button>
            </div>
        </div>
        
        <div class="font-selection">
            <button class="font-btn active" data-size="small">Small Font</button>
            <button class="font-btn" data-size="mono">Mono Font</button>
        </div>
    </div>

    <script>
        let previewUpdateInterval;
        
        // Create preview grid
        function createPreviewGrid() {
            const grid = document.getElementById('previewGrid');
            for (let i = 0; i < 256; i++) {
                const pixel = document.createElement('div');
                pixel.className = 'preview-pixel';
                pixel.id = 'pixel-' + i;
                grid.appendChild(pixel);
            }
        }
        
        // Update the preview grid
        function updatePreview() {
            fetch('/pixelStatus')
                .then(response => response.arrayBuffer())
                .then(buffer => {
                    const pixels = new Uint8Array(buffer);
                    for (let i = 0; i < 256; i++) {
                        const baseIndex = i * 3;
                        const r = pixels[baseIndex];
                        const g = pixels[baseIndex + 1];
                        const b = pixels[baseIndex + 2];
                        
                        const pixelElement = document.getElementById('pixel-' + i);
                        if (pixelElement) {
                            pixelElement.style.backgroundColor = `rgb(${r},${g},${b})`;
                        }
                    }
                })
                .catch(error => console.error('Error updating preview:', error));
        }
        
        document.addEventListener('DOMContentLoaded', function() {
            let activeTextColor = 'white';
            let activeBgColor = 'black';
            let textInput = document.getElementById('text-input');
            
            // Set active color button for text colors
            document.querySelectorAll('#textColors .color-btn').forEach(btn => {
                btn.addEventListener('click', function() {
                    document.querySelectorAll('#textColors .color-btn').forEach(b => b.classList.remove('active'));
                    this.classList.add('active');
                    activeTextColor = this.dataset.color;
                    updateDisplay();
                });
            });

            // Set active color button for background colors
            document.querySelectorAll('#bgColors .color-btn').forEach(btn => {
                btn.addEventListener('click', function() {
                    document.querySelectorAll('#bgColors .color-btn').forEach(b => b.classList.remove('active'));
                    this.classList.add('active');
                    activeBgColor = this.dataset.color;
                    updateDisplay();
                });
            });
            
            // Function to update the text display
            function updateDisplay() {
                let text = textInput.value || 'PixelBoard';
                let fontSize = document.querySelector('.font-btn.active').dataset.size;
                
                fetch(`/updatetext?text=${encodeURIComponent(text)}&textColor=${activeTextColor}&bgColor=${activeBgColor}&font=${fontSize}`)
                    .then(response => response.text())
                    .catch(error => console.error('Error:', error));
            }
            
            // Set active font button
            document.querySelectorAll('.font-btn').forEach(btn => {
                btn.addEventListener('click', function() {
                    document.querySelectorAll('.font-btn').forEach(b => b.classList.remove('active'));
                    this.classList.add('active');
                    updateDisplay();
                });
            });
            
            // Allow Enter key to submit
            textInput.addEventListener('keypress', function(e) {
                if (e.key === 'Enter') {
                    updateDisplay();
                }
            });
            
            // Update when text input changes
            textInput.addEventListener('input', updateDisplay);
            
            // Initialize
            createPreviewGrid();
            updatePreview();
            previewUpdateInterval = setInterval(updatePreview, 100);
        });
        
        // Clean up
        window.addEventListener('unload', function() {
            if (previewUpdateInterval) {
                clearInterval(previewUpdateInterval);
            }
        });
    </script>
</body>
</html>
)rawliteral";
        request->send(200, "text/html", html);
    });

    // API endpoint to update the text
    server->on("/updatetext", HTTP_GET, [](AsyncWebServerRequest *request) {
        if (request->hasParam("text") && request->hasParam("textColor") && request->hasParam("bgColor") && request->hasParam("font")) {
            String text = request->getParam("text")->value();
            String textColorStr = request->getParam("textColor")->value();
            String bgColorStr = request->getParam("bgColor")->value();
            String fontSize = request->getParam("font")->value();
            
            Serial.printf("Updating text: %s, Text Color: %s, Background Color: %s, Font: %s\n", 
                         text.c_str(), textColorStr.c_str(), bgColorStr.c_str(), fontSize.c_str());
            
            // Update text
            currentText = text;
            
            // Update text color
            if (textColorStr == "red") textColor = CRGB::Red;
            else if (textColorStr == "green") textColor = CRGB::Green;
            else if (textColorStr == "blue") textColor = CRGB::Blue;
            else if (textColorStr == "yellow") textColor = CRGB::Yellow;
            else if (textColorStr == "purple") textColor = CRGB::Purple;
            else if (textColorStr == "cyan") textColor = CRGB::Cyan;
            else textColor = CRGB::White; // Default to white

            // Update background color
            if (bgColorStr == "red") backgroundColor = CRGB::Red;
            else if (bgColorStr == "green") backgroundColor = CRGB::Green;
            else if (bgColorStr == "blue") backgroundColor = CRGB::Blue;
            else if (bgColorStr == "yellow") backgroundColor = CRGB::Yellow;
            else if (bgColorStr == "purple") backgroundColor = CRGB::Purple;
            else if (bgColorStr == "cyan") backgroundColor = CRGB::Cyan;
            else if (bgColorStr == "white") backgroundColor = CRGB::White;
            else backgroundColor = CRGB::Black; // Default to black
            
            // Update font size
            useMonoFont = (fontSize == "mono");
            
            request->send(200, "text/plain", "OK");
        } else {
            request->send(400, "text/plain", "Missing parameters");
        }
    });
} 